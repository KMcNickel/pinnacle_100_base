## oob_demo/Kconfig
```kconfig
# Copyright (c) 2020 Laird Connectivity
# SPDX-License-Identifier: Apache-2.0

menuconfig USER_APPLICATION
     bool "Config User Application"
	 default y

if USER_APPLICATION

config LAIRD_CONNECTIVITY_DEBUG
    bool
    default n

config CLOUD_QUEUE_SIZE
    int "The size of queue for sending messages to AWS or LWM2M client"
    default 32

config CLOUD_PURGE_THRESHOLD
    int "The threshold at which the cloud queue is purged."
    default 24

config CLOUD_FIFO_CHECK_RATE_SECONDS
    int "The rate at which the cloud fifo is checked"
    default 1

config JSON_LOG_PUBLISH
    bool "Print data published to AWS"

config JSON_LOG_TOPIC
    bool "Print the topic that documents are published to or received from"

config JSON_LOG_MQTT_RX_DATA
    bool "Enable/Disable printing of received MQTT data."

menuconfig LC_LWM2M
    bool "Laird Connectivity LWM2M Demo Options"
    depends on LWM2M

if LC_LWM2M

config LWM2M_ENABLE_PSK_GENERATION
    bool "Allow new PSK to be generated over Bluetooth"
    default y

config LWM2M_PSK_SIZE
    int
    default 16

config LWM2M_CLIENT_ID_MAX_SIZE
    int "Maximum size of the client id string"
    default 32
    range 1 64

config LWM2M_PEER_URL_MAX_SIZE
    int "Maximum size of the peer URL string"
    default 128
    range 1 512

config LWM2M_CLIENT_ENDPOINT_MAX_SIZE
    int "Maximum size of the client endpoint name"
    default 64

config LWM2M_PSK_TAG
    int "Tag used by TLS for referencing PSK"
    depends on LWM2M_DTLS_SUPPORT
    default 3
    help
        Must be unique in the system.

endif # LC_LWM2M

config JSMN_NUMBER_OF_TOKENS
    int "The number of tokens for jsmn"
    default 512
    help
        JSMN is used to process shadow and CoAP messages.
        The maximum size of the shadow (and tokens required) is affected by
        the number of sensors and the sensor log size.  The timestamps that are
        generated by AWS make the shadow large.

config APP_AWS_CUSTOMIZATION
    bool "Customize AWS connection"
    help
        Enabling this gives the user the ability to adjust all the pertinent AWS
        connection options via UART commands. This gives the user the ability
        to change what AWS server their device connects to.

if APP_AWS_CUSTOMIZATION

config APP_AWS_ROOT_CA_FILE_NAME
    string "Root CA file name"
    default "root_ca.pem"
    help
        Name of the file that the will be read from the filesystem

config APP_AWS_CLIENT_CERT_FILE_NAME
    string "Client cert file name"
    default "client_cert.pem"
    help
        Name of the file that the will be read from the filesystem

config APP_AWS_CLIENT_KEY_FILE_NAME
    string "Client key file name"
    default "client_key.pem"
    help
        Name of the file that the will be read from the filesystem

endif # APP_AWS_CUSTOMIZATION

endif # USER_APPLICATION

source "../modules/framework/Kconfig"

source "Kconfig.zephyr"
```
