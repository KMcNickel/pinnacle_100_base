## prj.conf
```kconfig
# General
CONFIG_MAIN_STACK_SIZE=8192
CONFIG_HEAP_MEM_POOL_SIZE=10240
CONFIG_NEWLIB_LIBC=y
CONFIG_NEWLIB_LIBC_FLOAT_PRINTF=y

# Debugging
# Use one of the following two options if debugging with breakpoints
# CONFIG_NO_OPTIMIZATIONS=y
# CONFIG_DEBUG_OPTIMIZATIONS=y

# App

# App debug
# CONFIG_VSP_TX_ECHO=y
# CONFIG_VSP_RX_ECHO=y
# CONFIG_JSON_LOG_ENABLED=y
# CONFIG_JSON_LOG_PUBLISH=y
# CONFIG_JSON_LOG_TOPIC=y
# CONFIG_JSON_LOG_MQTT_RX_DATA=y

# Bluetooth
CONFIG_BT=y
CONFIG_BT_GATT_DYNAMIC_DB=y
CONFIG_BT_CTLR_TX_PWR_PLUS_8=y
CONFIG_BT_CTLR_COMPANY_ID=0x0077
CONFIG_BT_MAX_CONN=3
CONFIG_BT_CTLR_DATA_LENGTH_MAX=251
CONFIG_BT_CTLR_TX_BUFFER_SIZE=251
CONFIG_BT_L2CAP_TX_MTU=260
CONFIG_BT_RX_BUF_LEN=260
CONFIG_BT_RX_STACK_SIZE=2048
# Allow Coded PHY (requires Nordic Bluetooth host)
CONFIG_BT_EXT_ADV=y
CONFIG_BT_LL_NRFXLIB_VS_INCLUDE=y
CONFIG_BT_LL_NRFXLIB_DEFAULT=y
# BLE Central settings
CONFIG_BT_CENTRAL=y
CONFIG_BT_GATT_CLIENT=y
# Enable simultaneous advertising and scanning
# (zephyr doesn't allow multiple random addresses)
CONFIG_BT_PRIVACY=n
CONFIG_BT_SCAN_WITH_IDENTITY=y
# The BT510 advertises at a 1-second rate (default of 3 seconds is too short)
CONFIG_BT_CREATE_CONN_TIMEOUT=6
# BLE Peripheral settings
CONFIG_BT_PERIPHERAL=y
CONFIG_BT_DEVICE_NAME="Pinnacle 100 OOB"
CONFIG_BT_DEVICE_NAME_DYNAMIC=y
# BLE security
CONFIG_BT_SMP=y
CONFIG_BT_BONDABLE=n
CONFIG_BT_MAX_PAIRED=3
# BLE debug
# CONFIG_BT_DEBUG_LOG=y
# CONFIG_BT_DEBUG_CONN=y
# CONFIG_BT_DEBUG_SMP=y

# modem settings
CONFIG_MODEM=y
CONFIG_MODEM_HL7800=y
CONFIG_MODEM_HL7800_RAT_M1=y
# CONFIG_MODEM_LOG_LEVEL_DBG=y
CONFIG_MODEM_HL7800_FW_UPDATE=y
CONFIG_MODEM_HL7800_RECV_BUF_CNT=64
CONFIG_NET_BUF_RX_COUNT=64

# NETWORKING
CONFIG_NETWORKING=y
CONFIG_NET_IPV4=y
CONFIG_NET_IPV6=n
CONFIG_NET_MGMT=y
CONFIG_NET_MGMT_EVENT=y
CONFIG_NET_SOCKETS=y
CONFIG_NET_SOCKETS_POSIX_NAMES=y
CONFIG_NET_SOCKETS_NET_MGMT=y
CONFIG_NET_SOCKETS_NET_MGMT_MAX_LISTENERS=3
CONFIG_NET_TCP=y
CONFIG_NET_CONFIG_INIT_TIMEOUT=2
CONFIG_NET_SHELL=y
CONFIG_NET_BUF_POOL_USAGE=y
CONFIG_COAP=y
CONFIG_NET_UDP=y

# Enable the DNS resolver
CONFIG_DNS_RESOLVER=y
CONFIG_NET_SOCKETS_DNS_TIMEOUT=10000

# MQTT
CONFIG_MQTT_LIB=y
# Security
CONFIG_MQTT_LIB_TLS=y
CONFIG_NET_SOCKETS_SOCKOPT_TLS=y
CONFIG_NET_SOCKETS_ENABLE_DTLS=y
CONFIG_NET_SOCKETS_TLS_MAX_CONTEXTS=2
CONFIG_TLS_MAX_CREDENTIALS_NUMBER=3
# TLS configuration
CONFIG_MBEDTLS=y
CONFIG_MBEDTLS_DTLS=y
CONFIG_MBEDTLS_BUILTIN=y
CONFIG_MBEDTLS_ENABLE_HEAP=y
CONFIG_MBEDTLS_HEAP_SIZE=55000
CONFIG_MBEDTLS_SSL_MAX_CONTENT_LEN=8192
CONFIG_MBEDTLS_PEM_CERTIFICATE_FORMAT=y
CONFIG_MBEDTLS_KEY_EXCHANGE_PSK_ENABLED=y
# Use format supported by Californium (CoAP bridge) and AWS.
CONFIG_MBEDTLS_KEY_EXCHANGE_ECDHE_ECDSA_ENABLED=y
CONFIG_MBEDTLS_ECP_ALL_ENABLED=y
CONFIG_MBEDTLS_CIPHER_GCM_ENABLED=y

# JSON used by AWS task
CONFIG_JSON_LIBRARY=y

# Storage
CONFIG_NVS=y
CONFIG_MPU_ALLOW_FLASH_WRITE=y
CONFIG_FLASH=y
CONFIG_FCB=y
CONFIG_FLASH_MAP=y
CONFIG_FLASH_PAGE_LAYOUT=y

# Enable mcumgr to support FOTA
CONFIG_MCUMGR=y
CONFIG_MCUMGR_SMP_SHELL=y
CONFIG_MCUMGR_SMP_SHELL_MTU=2048
CONFIG_MCUMGR_BUF_SIZE=2050
CONFIG_MGMT_CBORATTR_MAX_SIZE=2048
CONFIG_FS_MGMT_UL_CHUNK_SIZE=2048
# Enable the Bluetooth (unauthenticated) mcumgr transport.
CONFIG_MCUMGR_SMP_BT=y
CONFIG_MCUMGR_SMP_BT_AUTHEN=n

CONFIG_MCUMGR_CMD_IMG_MGMT=y
CONFIG_MCUMGR_CMD_OS_MGMT=y
CONFIG_MCUMGR_CMD_FS_MGMT=y
# Enable large files at the expense of larger CBOR encoding.
CONFIG_FS_MGMT_MAX_FILE_SIZE_4GB=y
# Some command handlers require a large stack.
CONFIG_SYSTEM_WORKQUEUE_STACK_SIZE=4096

# Enable the LittleFS file system.
#CONFIG_FILE_SYSTEM=y
#CONFIG_FILE_SYSTEM_LITTLEFS=y

# Enable QSPI (MX25R64)
#CONFIG_NORDIC_QSPI_NOR=y
#CONFIG_NORDIC_QSPI_NOR_FLASH_LAYOUT_PAGE_SIZE=4096
#CONFIG_NORDIC_QSPI_NOR_FLASH_ALLOW_STACK_USAGE_FOR_DATA_IN_FLASH=y
#CONFIG_PM_EXTERNAL_FLASH=y
#CONFIG_PM_EXTERNAL_FLASH_DEV_NAME="MX25R64"
#CONFIG_PM_EXTERNAL_FLASH_SIZE=0x800000
#CONFIG_PM_EXTERNAL_FLASH_BASE=0x0

# command line shell
CONFIG_SHELL=y
CONFIG_SHELL_HISTORY=n
CONFIG_KERNEL_SHELL=y
CONFIG_FILE_SYSTEM_SHELL=y

# Log messages
CONFIG_LOG=y
CONFIG_LOG_BUFFER_SIZE=2048
# for logging more dynamic strings
CONFIG_LOG_STRDUP_BUF_COUNT=16
CONFIG_LOG_STRDUP_MAX_STRING=64

# Networking debug
CONFIG_NET_LOG=y
# CONFIG_NET_SOCKETS_LOG_LEVEL_DBG=y
CONFIG_NET_SOCKETS_LOG_LEVEL_ERR=y
CONFIG_MBEDTLS_DEBUG=y
CONFIG_MBEDTLS_DEBUG_LEVEL=1
# CONFIG_NET_MGMT_EVENT_LOG_LEVEL_DBG=y

# Segger debugging tools
# CONFIG_SEGGER_SYSTEMVIEW=y
# CONFIG_USE_SEGGER_RTT=y

# Thread Debug
CONFIG_INIT_STACKS=y
CONFIG_THREAD_ANALYZER=y
CONFIG_THREAD_NAME=y
CONFIG_THREAD_MAX_NAME_LEN=12
#CONFIG_HW_STACK_PROTECTION=y
#CONFIG_STACK_SENTINEL=y
#CONFIG_STACK_CANARIES=y

# ADC for power measurement
CONFIG_ADC=y
CONFIG_ADC_NRFX_SAADC=y

# Allows rebooting in zephyr
CONFIG_REBOOT=y

# Message Framework
CONFIG_FWK_ASSERT_ENABLED=y
CONFIG_BUFFER_POOL_SIZE=16384

# Laird Connectivity Zephyr
CONFIG_LCZ_AD_FIND=y
CONFIG_LCZ_BT_SCAN=y

CONFIG_BLE_CELLULAR_SERVICE=y
CONFIG_BLE_POWER_SERVICE=y
CONFIG_LCZ_BLE_DIS=y

CONFIG_FILE_SYSTEM_UTILITIES=y
CONFIG_FOTA_SERVICE=y

CONFIG_LCZ_QRTC=y
CONFIG_LCZ_LED=y
CONFIG_LCZ_DNS=y
CONFIG_LCZ_POWER=y
CONFIG_LCZ_SOCK=y

# Use the Laird Connectivity Zephyr Library
CONFIG_COMPONENT_LIB=y

#NFC Support
CONFIG_LCZ_NFC=y
```

## src/main.c
```c
/**
 * @file main.c
 * @brief Application main entry point
 *
 * Copyright (c) 2020 Laird Connectivity
 *
 * SPDX-License-Identifier: Apache-2.0
 */

#include <logging/log.h>
#define LOG_LEVEL LOG_LEVEL_DBG
LOG_MODULE_REGISTER(main);

#define MAIN_LOG_ERR(...) LOG_ERR(__VA_ARGS__)
#define MAIN_LOG_WRN(...) LOG_WRN(__VA_ARGS__)
#define MAIN_LOG_INF(...) LOG_INF(__VA_ARGS__)
#define MAIN_LOG_DBG(...) LOG_DBG(__VA_ARGS__)

/******************************************************************************/
/* Includes                                                                   */
/******************************************************************************/
#include <stdio.h>
#include <zephyr/types.h>
#include <stddef.h>
#include <errno.h>
#include <zephyr.h>
#include <version.h>
#include <shell/shell.h>
#include <shell/shell_uart.h>

#include "led_configuration.h"
#include "lte.h"
#include "laird_power.h"
#include "dis.h"
#include "FrameworkIncludes.h"
#include "laird_utility_macros.h"
#include "string_util.h"
#include "app_version.h"

#ifdef CONFIG_MCUMGR
#include "mcumgr_wrapper.h"
#endif

/******************************************************************************/
/* Local Constant, Macro and Type Definitions                                 */
/******************************************************************************/
#define WAIT_TIME_BEFORE_RETRY_TICKS K_SECONDS(10)

#define NUMBER_OF_IMEI_DIGITS_TO_USE_IN_DEV_NAME 7

enum CREDENTIAL_TYPE { CREDENTIAL_CERT, CREDENTIAL_KEY };

typedef void (*app_state_function_t)(void);

#if defined(CONFIG_SHELL) && defined(CONFIG_MODEM_HL7800)
#define APN_MSG "APN: [%s]"
#endif

/******************************************************************************/
/* Global Data Definitions                                                    */
/******************************************************************************/
#if defined(CONFIG_SHELL) && defined(CONFIG_MODEM_HL7800)
extern struct mdm_hl7800_apn *lte_apn_config;
#endif

/******************************************************************************/
/* Local Data Definitions                                                     */
/******************************************************************************/
K_SEM_DEFINE(lte_ready_sem, 0, 1);

static bool appReady = false;

static app_state_function_t appState;
struct lte_status *lteInfo;

K_MSGQ_DEFINE(cloudQ, FWK_QUEUE_ENTRY_SIZE, CONFIG_CLOUD_QUEUE_SIZE,
	      FWK_QUEUE_ALIGNMENT);

/******************************************************************************/
/* Local Function Prototypes                                                  */
/******************************************************************************/
static void appStateWaitForLte(void);
static void appStateStartup(void);
static void appStateLteConnected(void);

static void appSetNextState(app_state_function_t next);
static const char *getAppStateString(app_state_function_t state);

static void lteEvent(enum lte_event event);
static void softwareReset(uint32_t DelayMs);

static void configure_leds(void);

/******************************************************************************/
/* Global Function Definitions                                                */
/******************************************************************************/
void main(void)
{
	int rc;

	printk("\nPinnacle 100 App v%s\n", APP_VERSION_STRING);

	configure_leds();

	Framework_Initialize();

	lteRegisterEventCallback(lteEvent);
	rc = lteInit();
	if (rc < 0) {
		MAIN_LOG_ERR("LTE init (%d)", rc);
		goto exit;
	}
	lteInfo = lteGetStatus();

	dis_initialize(APP_VERSION_STRING);

#ifdef CONFIG_MCUMGR
	mcumgr_wrapper_register_subsystems();
#endif

	appReady = true;
	printk("\n!!!!!!!! App is ready! !!!!!!!!\n");

	appSetNextState(appStateStartup);

	while (true) {
		appState();
	}
exit:
	MAIN_LOG_ERR("Exiting main thread");
	return;
}

/******************************************************************************/
/* Framework                                                                  */
/******************************************************************************/
EXTERNED void Framework_AssertionHandler(char *file, int line)
{
	static atomic_t busy = ATOMIC_INIT(0);
	/* prevent recursion (buffer alloc fail, ...) */
	if (!busy) {
		atomic_set(&busy, 1);
		LOG_ERR("\r\n!---> Framework Assertion <---! %s:%d\r\n", file,
			line);
		LOG_ERR("Thread name: %s",
			log_strdup(k_thread_name_get(k_current_get())));
	}

#ifdef CONFIG_LAIRD_CONNECTIVITY_DEBUG
	/* breakpoint location */
	volatile bool wait = true;
	while (wait)
		;
#endif

	softwareReset(CONFIG_FWK_RESET_DELAY_MS);
}

/******************************************************************************/
/* Local Function Definitions                                                 */
/******************************************************************************/

static void lteEvent(enum lte_event event)
{
	switch (event) {
	case LTE_EVT_READY:
		k_sem_give(&lte_ready_sem);
		break;
	case LTE_EVT_DISCONNECTED:
		k_sem_reset(&lte_ready_sem);
		break;
	default:
		break;
	}
}

static const char *getAppStateString(app_state_function_t state)
{
	IF_RETURN_STRING(state, appStateStartup);
	IF_RETURN_STRING(state, appStateWaitForLte);
	IF_RETURN_STRING(state, appStateLteConnected);
	return "appStateUnknown";
}

static void appSetNextState(app_state_function_t next)
{
	MAIN_LOG_DBG("%s->%s", getAppStateString(appState),
		     getAppStateString(next));
	appState = next;
}

static void appStateStartup(void)
{
	appSetNextState(appStateWaitForLte);
}

static void appStateWaitForLte(void)
{
	if (!lteIsReady()) {
		/* Wait for LTE ready evt */
		k_sem_take(&lte_ready_sem, K_FOREVER);
	}
	appSetNextState(appStateLteConnected);
}
 // For an implementation set the above "appSetNextState" function call to the needed state.

static void appStateLteConnected(void)
{
	k_sleep(K_SECONDS(1));
}

static void softwareReset(uint32_t DelayMs)
{
#ifdef CONFIG_REBOOT
	LOG_ERR("Software Reset in %d milliseconds", DelayMs);
	k_sleep(K_MSEC(DelayMs));
	power_reboot_module(REBOOT_TYPE_NORMAL);
#endif
}

static void configure_leds(void)
{
	struct led_configuration c[] = {
		{ BLUE_LED1, LED1_DEV, LED1, LED_ACTIVE_HIGH },
		{ GREEN_LED2, LED2_DEV, LED2, LED_ACTIVE_HIGH },
		{ RED_LED3, LED3_DEV, LED3, LED_ACTIVE_HIGH },
		{ GREEN_LED4, LED4_DEV, LED4, LED_ACTIVE_HIGH }
	};
	led_init(c, ARRAY_SIZE(c));
}

/******************************************************************************/
/* Interrupt Service Routines                                                 */
/******************************************************************************/
```

## include/app_version.h
```c
/**
 * @file app_version.h
 * @brief
 *
 * Copyright (c) 2020 Laird Connectivity
 *
 * SPDX-License-Identifier: Apache-2.0
 */
#ifndef __APP_VERSION_H__
#define __APP_VERSION_H__

#ifdef __cplusplus
extern "C" {
#endif

/******************************************************************************/
/* Application Firmware Version                                               */
/******************************************************************************/
#define APP_VERSION_MAJOR 0
#define APP_VERSION_MINOR 0
#define APP_VERSION_PATCH 0
#define APP_VERSION_STRING                                                     \
	STRINGIFY(APP_VERSION_MAJOR)                                           \
	"." STRINGIFY(APP_VERSION_MINOR) "." STRINGIFY(APP_VERSION_PATCH)

#ifdef __cplusplus
}
#endif

#endif /* __APP_VERSION_H__ */
```

## src/lte.c
```c
/**
 * @file lte.c
 * @brief LTE management
 *
 * Copyright (c) 2020 Laird Connectivity
 *
 * SPDX-License-Identifier: Apache-2.0
 */

#include <logging/log.h>
#define LOG_LEVEL LOG_LEVEL_DBG
LOG_MODULE_REGISTER(app_lte);

#define LTE_LOG_ERR(...) LOG_ERR(__VA_ARGS__)
#define LTE_LOG_WRN(...) LOG_WRN(__VA_ARGS__)
#define LTE_LOG_INF(...) LOG_INF(__VA_ARGS__)
#define LTE_LOG_DBG(...) LOG_DBG(__VA_ARGS__)

/******************************************************************************/
/* Includes                                                                   */
/******************************************************************************/
#include <zephyr.h>
#include <net/net_if.h>
#include <net/net_core.h>
#include <net/net_context.h>
#include <net/net_mgmt.h>
#include <net/socket.h>

#include <drivers/modem/hl7800.h>
#include "ble_cellular_service.h"
#include "fota.h"
#include "led_configuration.h"
#include "qrtc.h"

#include "lte.h"

/******************************************************************************/
/* Global Data Definitions                                                    */
/******************************************************************************/
#ifdef CONFIG_BLUEGRASS
extern bool initShadow;
#endif

struct mdm_hl7800_apn *lte_apn_config;

/******************************************************************************/
/* Local Constant, Macro and Type Definitions                                 */
/******************************************************************************/
struct mgmt_events {
	uint32_t event;
	net_mgmt_event_handler_t handler;
	struct net_mgmt_event_callback cb;
};

static const struct led_blink_pattern NETWORK_SEARCH_LED_PATTERN = {
	.on_time = CONFIG_DEFAULT_LED_ON_TIME_FOR_1_SECOND_BLINK,
	.off_time = CONFIG_DEFAULT_LED_OFF_TIME_FOR_1_SECOND_BLINK,
	.repeat_count = REPEAT_INDEFINITELY
};

/******************************************************************************/
/* Local Function Prototypes                                                  */
/******************************************************************************/
static void onLteEvent(enum lte_event event);

static void iface_ready_evt_handler(struct net_mgmt_event_callback *cb,
				    uint32_t mgmt_event, struct net_if *iface);
static void iface_down_evt_handler(struct net_mgmt_event_callback *cb,
				   uint32_t mgmt_event, struct net_if *iface);

static void setup_iface_events(void);

static void modemEventCallback(enum mdm_hl7800_event event, void *event_data);

static void getLocalTimeFromModemWorkHandler(struct k_work *item);

/******************************************************************************/
/* Local Data Definitions                                                     */
/******************************************************************************/
static struct net_if *iface;
static struct net_if_config *cfg;
static struct dns_resolve_context *dns;
static struct lte_status lteStatus;
static lte_event_function_t lteCallbackFunction = NULL;
struct k_work localTimeWork;
static struct tm localTime;
static int32_t localOffset;

static struct mgmt_events iface_events[] = {
	{ .event = NET_EVENT_DNS_SERVER_ADD,
	  .handler = iface_ready_evt_handler },
	{ .event = NET_EVENT_IF_DOWN, .handler = iface_down_evt_handler },
	{ 0 } /* The for loop below requires this extra location. */
};

/******************************************************************************/
/* Global Function Definitions                                                */
/******************************************************************************/
void lteRegisterEventCallback(lte_event_function_t callback)
{
	lteCallbackFunction = callback;
}

int lteInit(void)
{
	int rc = LTE_ERR_NONE;
	mdm_hl7800_register_event_callback(modemEventCallback);
	setup_iface_events();
	k_work_init(&localTimeWork, getLocalTimeFromModemWorkHandler);

	/* wait for network interface to be ready */
	iface = net_if_get_default();
	if (!iface) {
		LTE_LOG_ERR("Could not get iface");
		rc = LTE_ERR_NO_IFACE;
		goto exit;
	}

	cfg = net_if_get_config(iface);
	if (!cfg) {
		LTE_LOG_ERR("Could not get iface config");
		rc = LTE_ERR_IFACE_CFG;
		goto exit;
	}

	dns = dns_resolve_get_default();
	if (!dns) {
		LTE_LOG_ERR("Could not get DNS context");
		rc = LTE_ERR_DNS_CFG;
		goto exit;
	}

	lteStatus.radio_version = (const char *)mdm_hl7800_get_fw_version();
	lteStatus.IMEI = (const char *)mdm_hl7800_get_imei();
	lteStatus.ICCID = (const char *)mdm_hl7800_get_iccid();
	lteStatus.serialNumber = (const char *)mdm_hl7800_get_sn();
	mdm_hl7800_generate_status_events();

exit:
	return rc;
}

bool lteIsReady(void)
{
	struct sockaddr_in *dnsAddr;

	if (iface != NULL && cfg != NULL && &dns->servers[0] != NULL) {
		dnsAddr = net_sin(&dns->servers[0].dns_server);
		return net_if_is_up(iface) && cfg->ip.ipv4 &&
		       !net_ipv4_is_addr_unspecified(&dnsAddr->sin_addr);
	}

	return false;
}

struct lte_status *lteGetStatus(void)
{
	mdm_hl7800_get_signal_quality(&lteStatus.rssi, &lteStatus.sinr);
	return &lteStatus;
}

/******************************************************************************/
/* Local Function Definitions                                                 */
/******************************************************************************/
static void onLteEvent(enum lte_event event)
{
	if (lteCallbackFunction != NULL) {
		lteCallbackFunction(event);
	}
}

static void iface_ready_evt_handler(struct net_mgmt_event_callback *cb,
				    uint32_t mgmt_event, struct net_if *iface)
{
	if (mgmt_event != NET_EVENT_DNS_SERVER_ADD) {
		return;
	}

	LTE_LOG_DBG("LTE is ready!");
	led_turn_on(RED_LED3);
	onLteEvent(LTE_EVT_READY);
	k_work_submit(&localTimeWork);
}

static void iface_down_evt_handler(struct net_mgmt_event_callback *cb,
				   uint32_t mgmt_event, struct net_if *iface)
{
	if (mgmt_event != NET_EVENT_IF_DOWN) {
		return;
	}

	LTE_LOG_DBG("LTE is down");
	led_turn_off(RED_LED3);
	onLteEvent(LTE_EVT_DISCONNECTED);
}

static void setup_iface_events(void)
{
	int i;

	for (i = 0; iface_events[i].event; i++) {
		net_mgmt_init_event_callback(&iface_events[i].cb,
					     iface_events[i].handler,
					     iface_events[i].event);

		net_mgmt_add_event_callback(&iface_events[i].cb);
	}
}

static void modemEventCallback(enum mdm_hl7800_event event, void *event_data)
{
	uint8_t code = ((struct mdm_hl7800_compound_event *)event_data)->code;
	switch (event) {
	case HL7800_EVENT_NETWORK_STATE_CHANGE:
		cell_svc_set_network_state(code);

		switch (code) {
		case HL7800_HOME_NETWORK:
		case HL7800_ROAMING:
			led_turn_on(RED_LED3);
			break;

		case HL7800_REGISTRATION_DENIED:
		case HL7800_UNABLE_TO_CONFIGURE:
		case HL7800_OUT_OF_COVERAGE:
			led_turn_off(RED_LED3);
			break;

		case HL7800_NOT_REGISTERED:
		case HL7800_SEARCHING:
			led_blink(RED_LED3, &NETWORK_SEARCH_LED_PATTERN);
			break;

		case HL7800_EMERGENCY:
		default:
			led_turn_off(RED_LED3);
			break;
		}
		break;

	case HL7800_EVENT_APN_UPDATE:
		/* event data points to static data stored in modem driver.
		 * Store the pointer so we can access the APN elsewhere in our app.
		 */
		lte_apn_config = (struct mdm_hl7800_apn *)event_data;
		cell_svc_set_apn(lte_apn_config);
		break;

	case HL7800_EVENT_RSSI:
		cell_svc_set_rssi(*((int *)event_data));
		break;

	case HL7800_EVENT_SINR:
		cell_svc_set_sinr(*((int *)event_data));
		break;

	case HL7800_EVENT_STARTUP_STATE_CHANGE:
		cell_svc_set_startup_state(code);
		switch (code) {
		case HL7800_STARTUP_STATE_READY:
		case HL7800_STARTUP_STATE_WAITING_FOR_ACCESS_CODE:
			break;
		case HL7800_STARTUP_STATE_SIM_NOT_PRESENT:
		case HL7800_STARTUP_STATE_SIMLOCK:
		case HL7800_STARTUP_STATE_UNRECOVERABLE_ERROR:
		case HL7800_STARTUP_STATE_UNKNOWN:
		case HL7800_STARTUP_STATE_INACTIVE_SIM:
		default:
			led_turn_off(RED_LED3);
			break;
		}
		break;

	case HL7800_EVENT_SLEEP_STATE_CHANGE:
		cell_svc_set_sleep_state(code);
		break;

	case HL7800_EVENT_RAT:
		cell_svc_set_rat(*((uint8_t *)event_data));
		break;

	case HL7800_EVENT_BANDS:
		cell_svc_set_bands((char *)event_data);
		break;

	case HL7800_EVENT_ACTIVE_BANDS:
		cell_svc_set_active_bands((char *)event_data);
		break;

	case HL7800_EVENT_FOTA_STATE:
		if (IS_ENABLED(CONFIG_FOTA_SERVICE)) {
			fota_state_handler(*((uint8_t *)event_data));
		}
		break;

	case HL7800_EVENT_FOTA_COUNT:
		if (IS_ENABLED(CONFIG_FOTA_SERVICE)) {
			fota_set_count(*((uint32_t *)event_data));
		}
		break;

	case HL7800_EVENT_REVISION:
		cell_svc_set_fw_ver((char *)event_data);
#ifdef CONFIG_BLUEGRASS
		/* Update shadow because modem version has changed. */
		initShadow = true;
#endif
#ifdef CONFIG_COAP_FOTA
		/* This is duplicated for backwards compatability. */
		coap_fota_set_running_version(MODEM_IMAGE_TYPE,
					      (char *)event_data,
					      strlen((char *)event_data));
#endif
		break;

	default:
		LOG_ERR("Unknown modem event");
		break;
	}
}

static void getLocalTimeFromModemWorkHandler(struct k_work *item)
{
	ARG_UNUSED(item);

	if (!Qrtc_EpochWasSet()) {
		int32_t status =
			mdm_hl7800_get_local_time(&localTime, &localOffset);
		if (status == 0) {
			LOG_INF("Epoch set to %u",
				Qrtc_SetEpochFromTm(&localTime, localOffset));
		}
	}
}
```
